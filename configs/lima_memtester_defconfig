## configs/lima_memtester_defconfig
```kconfig
# Architecture
BR2_arm=y
BR2_cortex_a8=y
BR2_ARM_EABIHF=y
BR2_ARM_FPU_NEON=y
BR2_ARM_INSTRUCTIONS_THUMB2=y

# System configuration
BR2_TARGET_GENERIC_HOSTNAME="lima-memtester"
BR2_TARGET_GENERIC_ISSUE="Welcome!"
BR2_TARGET_GENERIC_GETTY=y
BR2_TARGET_GENERIC_GETTY_PORT="ttyS0"

# Lock to 3.17 headers to avoid breaking with newer kernels
BR2_KERNEL_HEADERS_VERSION=y
BR2_DEFAULT_KERNEL_VERSION="3.17"
BR2_PACKAGE_HOST_LINUX_HEADERS_CUSTOM_3_17=y

BR2_TOOLCHAIN_BUILDROOT_GLIBC=y

BR2_PACKAGE_RUBY=y
BR2_PACKAGE_LIMA_MEMTESTER=y
BR2_PACKAGE_BUSYBOX_SHOW_OTHERS=y

BR2_TARGET_ROOTFS_CPIO=y
BR2_TARGET_ROOTFS_CPIO_LZMA=y
BR2_TARGET_ROOTFS_CPIO_UIMAGE=y

BR2_ROOTFS_OVERLAY="board/sunxi/lima_memtester/rootfs_overlay"
```

## configs/sunxi_bootsetup_defconfig
```kconfig
# Architecture
BR2_arm=y
BR2_cortex_a8=y
BR2_ARM_EABIHF=y
BR2_ARM_FPU_NEON=y
BR2_ARM_INSTRUCTIONS_THUMB2=y

# System configuration
BR2_TARGET_GENERIC_HOSTNAME="sunxi"
BR2_TARGET_GENERIC_ISSUE="Welcome to use sunxi bootsetup!"
BR2_TARGET_GENERIC_GETTY=y
BR2_TARGET_GENERIC_GETTY_PORT="ttyS0"

# Lock to 3.17 headers to avoid breaking with newer kernels
BR2_KERNEL_HEADERS_VERSION=y
BR2_DEFAULT_KERNEL_VERSION="3.17"
BR2_PACKAGE_HOST_LINUX_HEADERS_CUSTOM_3_17=y

BR2_TOOLCHAIN_BUILDROOT_GLIBC=y

BR2_PACKAGE_RUBY=y
BR2_PACKAGE_DIALOG_SUNXI=y
BR2_PACKAGE_LIMA_MEMTESTER=y
BR2_PACKAGE_A10_DRAM_TOOLS=y
BR2_PACKAGE_SUNXI_BOOTSETUP=y
BR2_PACKAGE_BUSYBOX_SHOW_OTHERS=y
BR2_PACKAGE_DEVMEM2=y

BR2_TARGET_ROOTFS_CPIO=y
BR2_TARGET_ROOTFS_TAR=y
BR2_TARGET_ROOTFS_CPIO_UIMAGE=y

BR2_ROOTFS_OVERLAY="board/sunxi/bootsetup/rootfs_overlay"
```

## package/a10-dram-tools/Config.in
```kconfig
config BR2_PACKAGE_A10_DRAM_TOOLS
	bool "a10-dram-tools"
	depends on BR2_PACKAGE_LIMA_MEMTESTER
	depends on BR2_PACKAGE_RUBY
	help
	  This is a set of tools, which can assist in configuring the Allwinner
	  A10/A13/A20 DRAM controller.

	  https://github.com/ssvb/a10-dram-tools
```

## package/dialog-sunxi/Config.in
```kconfig
config BR2_PACKAGE_DIALOG_SUNXI
	bool "dialog"
	depends on BR2_TOOLCHAIN_HAS_THREADS # fork()
	depends on BR2_USE_MMU # fork()
	select BR2_PACKAGE_NCURSES
	select BR2_PACKAGE_LIBICONV if !BR2_ENABLE_LOCALE
	help
	  dialog-sunxi - display dialog boxes from shell scripts

	  This application provides a method of displaying several different
	  types of dialog boxes from shell scripts.  This allows a developer
	  of a script to interact with the user in a much friendlier manner.

	  http://invisible-island.net/dialog/dialog.html
	
	  Modified to enable the use of Allwinner FEL button.

comment "dialog needs a toolchain w/ threads"
	depends on !BR2_TOOLCHAIN_HAS_THREADS
	depends on BR2_USE_MMU
```

## package/lima-memtester/Config.in
```kconfig
config BR2_PACKAGE_LIMA_MEMTESTER
	bool "lima-memtester"
	help
	  This is a memory reliability testing tool, implemented by combining
	  http://limadriver.org/ and http://pyropus.ca/software/memtester/

	  https://github.com/ssvb/lima-memtester
```

## package/sunxi-bootsetup/Config.in
```kconfig
config BR2_PACKAGE_SUNXI_BOOTSETUP
	bool "sunxi-bootsetup"
	depends on BR2_PACKAGE_A10_DRAM_TOOLS
	depends on BR2_PACKAGE_RUBY
	help
	  A set of scripts to provide installer initramfs for
	  Allwinner hardware.

	  https://github.com/ssvb/sunxi-bootsetup
```
